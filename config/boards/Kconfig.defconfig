## config/boards/Kconfig.defconfig
```kconfig
if SHIELD_CORNBLE_LEFT || SHIELD_CORNBLE_RIGHT

config ZMK_KEYBOARD_NAME
    default "Cornble"

endif
```

## config/boards/arm/tayo/Kconfig.board
```kconfig
# SPDX-License-Identifier: MIT
config BOARD_TAYO
    bool "tayo"
    depends on SOC_NRF52840_QIAA
```

## config/boards/shields/corner/Kconfig.defconfig
```kconfig
if SHIELD_CORNER_LEFT

config ZMK_KEYBOARD_NAME
    default "Corner"

endif

if SHIELD_CORNER_RIGHT

config ZMK_KEYBOARD_NAME
    default "Corner"

endif
```

## config/boards/shields/corner/Kconfig.shield
```kconfig
config SHIELD_CORNER_LEFT
    def_bool $(shields_list_contains,corner_left)

config SHIELD_CORNER_RIGHT
    def_bool $(shields_list_contains,corner_right)
```
